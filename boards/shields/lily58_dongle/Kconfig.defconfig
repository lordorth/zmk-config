## boards/shields/lily58_dongle/Kconfig.defconfig
```kconfig
if SHIELD_LILY58_DONGLE

config ZMK_KEYBOARD_NAME
    default "Lily58 Dongle"

config ZMK_SPLIT_ROLE_CENTRAL
    default y

endif
```

## config/west.yml
```yaml
manifest:
  remotes:
    - name: zmkfirmware
      url-base: https://github.com/zmkfirmware
    - name: lordorth
      url-base: https://github.com/lordorth
    # Additional modules containing boards/shields/custom code can be listed here as well
    # See https://docs.zephyrproject.org/3.2.0/develop/west/manifest.html#projects
  projects:
    - name: zmk
      remote: zmkfirmware
      revision: v0.3
      import: app/west.yml
    - name: zmk-dongle-display
      remote: lordorth
      revision: main
  self:
    path: config
```
