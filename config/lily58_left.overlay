/*
 * Disable OLED and I2C to prevent boot hangs on boards without displays
 */

&pro_micro_i2c {
    status = "disabled";
};

&oled {
    status = "disabled";
};

/* Optional: Disable encoder if not present, though usually harmless */
/*
&left_encoder {
    status = "disabled";
};
*/
