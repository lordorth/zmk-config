// Debug overlay for Lily58 Right
// Disabling the matrix scan to rule out pin shorts causing boot failures.

/ {
    chosen {
        zmk,kscan = &mock_kscan;
    };

    mock_kscan: mock_kscan {
        compatible = "zmk,kscan-mock";
        rows = <1>;
        columns = <1>;
        events = <0>;
        status = "okay";
    };

    kscan_0 {
        status = "disabled";
    };
};
